/**
 * These arguments were used when this file was generated. They will be automatically applied on subsequent loads
 * via the GUI or CLI. Run CLI with '--help' for additional information on how to override these arguments.
 * @cliArgs --board "/ti/boards/LP_MSPM0G3507" --product "mspm0_sdk@2.09.00.00"
 * @v2CliArgs --board "/ti/boards/LP_MSPM0G3507" --product "mspm0_sdk@2.09.00.00"
 * @versions {"tool":"1.26.2+4477"}
 */

/**
 * Import the modules used in this configuration.
 */
const GPIO  = scripting.addModule("/ti/driverlib/GPIO", {}, false);
const GPIO1 = GPIO.addInstance();
const I2C   = scripting.addModule("/ti/driverlib/I2C", {}, false);
const I2C1  = I2C.addInstance();
const I2C2  = I2C.addInstance();
const UART  = scripting.addModule("/ti/driverlib/UART", {}, false);
const UART1 = UART.addInstance();

/**
 * Write custom configuration values to the imported modules.
 */
GPIO1.$name                                 = "GPIO_GRP_0";
GPIO1.associatedPins[0].$name               = "PIN_0";
GPIO1.associatedPins[0].assignedPort        = "PORTB";
GPIO1.associatedPins[0].assignedPortSegment = "Upper";
GPIO1.associatedPins[0].assignedPin         = "22";

const Board = scripting.addModule("/ti/driverlib/Board", {}, false);

I2C1.basicEnableController   = true;
I2C1.basicControllerBusSpeed = 400000;
I2C1.advControllerTXFIFOTRIG = "BYTES_1";
I2C1.intController = [
    "ARBITRATION_LOST",
    "NACK",
    "RXFIFO_TRIGGER",
    "TXFIFO_TRIGGER",
    "RX_DONE",
    "TX_DONE"
];
I2C1.$name                     = "I2C_0";
I2C1.sdaPinConfig.$name        = "ti_driverlib_gpio_GPIOPinGeneric6";
I2C1.sclPinConfig.$name        = "ti_driverlib_gpio_GPIOPinGeneric7";
I2C1.peripheral.$assign        = "I2C1";
I2C1.peripheral.sdaPin.$assign = "PB3";
I2C1.peripheral.sclPin.$assign = "PB2";

I2C2.basicEnableController   = true;
I2C2.basicControllerBusSpeed = 400000;
I2C2.advControllerTXFIFOTRIG = "BYTES_1";
I2C2.intController = [
    "ARBITRATION_LOST",
    "NACK",
    "RXFIFO_TRIGGER",
    "TXFIFO_TRIGGER",
    "RX_DONE",
    "TX_DONE"
];
I2C2.$name                     = "I2C_1";
I2C2.sdaPinConfig.$name        = "ti_driverlib_gpio_GPIOPinGeneric8";
I2C2.sclPinConfig.$name        = "ti_driverlib_gpio_GPIOPinGeneric9";
I2C2.peripheral.$assign        = "I2C0";
I2C2.peripheral.sdaPin.$assign = "PA28";
I2C2.peripheral.sclPin.$assign = "PA31";

const SYSCTL = scripting.addModule("/ti/driverlib/SYSCTL", {}, false);

UART1.$name             = "UART_0";
UART1.enabledInterrupts = ["RX","TX"];
UART1.targetBaudRate    = 2000000;
UART1.txPinConfig.$name = "ti_driverlib_gpio_GPIOPinGeneric0";
UART1.rxPinConfig.$name = "ti_driverlib_gpio_GPIOPinGeneric1";

/**
 * Pinmux solution for unlocked pins/peripherals. This ensures that minor changes to the automatic solver in a future
 * version of the tool will not impact the pinmux you originally saw.  These lines can be completely deleted in order to
 * re-solve from scratch.
 */
GPIO1.associatedPins[0].pin.$suggestSolution        = "j19_expansion.5";
Board.peripheral.$suggestSolution                   = "DEBUGSS";
Board.peripheral.swclkPin.$suggestSolution          = "j25_expansion.16";
Board.peripheral.swdioPin.$suggestSolution          = "j25_expansion.14";
I2C1.peripheral.$suggestSolution                    = "I2C1";
I2C1.peripheral.sdaPin.$suggestSolution             = "boosterpack.3";
I2C1.peripheral.sclPin.$suggestSolution             = "boosterpack.4";
I2C2.peripheral.$suggestSolution                    = "I2C0";
I2C2.peripheral.sdaPin.$suggestSolution             = "j17_expansion.2";
I2C2.peripheral.sclPin.$suggestSolution             = "j17_expansion.4";
SYSCTL.peripheral.$suggestSolution                  = "SYSCTL";
UART1.peripheral.$suggestSolution                   = "UART0";
UART1.peripheral.rxPin.$suggestSolution             = "j17_expansion.9";
UART1.peripheral.txPin.$suggestSolution             = "j19_expansion.9";

